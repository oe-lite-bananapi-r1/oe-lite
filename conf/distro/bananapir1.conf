## conf/distro/bananapir1.conf
```bitbake
#@TYPE: Distribution
#@NAME: Banana Pi R1
#@DESCRIPTION: OE-lite distro for Banana Pi R1

require conf/distro/busybox-full.conf
require conf/distro/linaro.conf

DISTRO_VERSION = "0.1"

#
# Common options
#
DISTRO_USE_sysvinit = "1"
DISTRO_USE_crontab = "1"
DISTRO_USE_mdev = "1"
DISTRO_USE_inetd = "1"

DISTRO_USE_passwd_root = "$1$L9mzJfTZ$2ED5as2K2yZ98CN/BQuy1."

#
# Base-files setup
# 
DISTRO_USE_hostname = "bpi_r1-host"
DISTRO_USE_busybox_ntpd_configuration = "-p 0.europe.pool.ntp.org -p 1.europe.pool.ntp.org"

#
# pinned versions / preferred
#
prefer recipe linux-headers
prefer recipe linux version 4.13
```

## conf/distro/busybox-full.conf
```bitbake
DISTRO_USE_busybox_init_shutdown_umount = "1"
DISTRO_USE_busybox_init = "1"
DISTRO_USE_busybox_runit = "1"
DISTRO_USE_busybox_klogd = "1"
DISTRO_USE_busybox_syslogd = "1"
DISTRO_USE_busybox_syslogd_ipc = "1"
DISTRO_USE_busybox_syslogd_remote = "1"
DISTRO_USE_busybox_syslogd_rotate = "1"
DISTRO_USE_busybox_hwclock_crontab = "1"
DISTRO_USE_busybox_cron = "1"
DISTRO_USE_busybox_watchdog = "1"
DISTRO_USE_busybox_udhcpc = "1"
DISTRO_USE_busybox_udhcpd = "1"
DISTRO_USE_busybox_tftpd_dir = "1"
DISTRO_USE_busybox_ftpd_dir = "1"
DISTRO_USE_busybox_ash = "1"
DISTRO_USE_busybox_start_stop_daemon = "1"
DISTRO_USE_busybox_mdev = "1"
DISTRO_USE_busybox_logger = "1"
DISTRO_USE_busybox_hwclock = "1"
DISTRO_USE_busybox_udhcpc_rfc3397 = "1"
DISTRO_USE_busybox_inetd = "0" #depends on glibc with RPC headers, see: http://comments.gmane.org/gmane.comp.lib.uclibc.buildroot/42730
DISTRO_USE_busybox_echo = "1"
DISTRO_USE_busybox_discard = "1"
DISTRO_USE_busybox_time = "1"
DISTRO_USE_busybox_daytime = "1"
DISTRO_USE_busybox_chargen = "1"
DISTRO_USE_busybox_rpc = "1"
DISTRO_USE_busybox_ntpd = "1"
DISTRO_USE_busybox_ntpd_server = "1"
DISTRO_USE_busybox_httpd = "1"
DISTRO_USE_busybox_tftp = "1"
DISTRO_USE_busybox_nc = "1"
DISTRO_USE_busybox_tftpd = "0" #depends on inetd
DISTRO_USE_busybox_ftpd = "0" #Depends on inetd
DISTRO_USE_busybox_telnetd = "0" #depends on inetd
DISTRO_USE_busybox_stat = "1"
DISTRO_USE_busybox_which = "1"
DISTRO_USE_busybox_tee = "1"
DISTRO_USE_busybox_su = "1"
DISTRO_USE_busybox_ash_alias = "1"
DISTRO_USE_busybox_sh_math_support_64 = "1"
DISTRO_USE_busybox_feature_verbose_usage = "1"
DISTRO_USE_busybox_unzip = "1"
DISTRO_USE_busybox_dos2unix = "1"
DISTRO_USE_busybox_unix2dos = "1"
DISTRO_USE_busybox_nice = "1"
DISTRO_USE_busybox_runlevel = "1"
DISTRO_USE_busybox_arp = "1"
DISTRO_USE_busybox_traceroute = "1"
DISTRO_USE_busybox_cttyhack = "1"
DISTRO_USE_busybox_gunzip = "1"
DISTRO_USE_busybox_bzip2 = "1"
DISTRO_USE_busybox_bunzip2 = "1"
DISTRO_USE_busybox_feature_tar_oldgnu_compatibility = "1"
DISTRO_USE_busybox_unxz = "1"
DISTRO_USE_busybox_unlzma = "1"
DISTRO_USE_busybox_lzop = "1"
DISTRO_USE_busybox_feature_date_isofmt = "1"
DISTRO_USE_busybox_feature_date_nano = "1"
DISTRO_USE_busybox_feature_date_compat = "1"
DISTRO_USE_busybox_tr = "1"
DISTRO_USE_busybox_install = "1"
DISTRO_USE_busybox_feature_ls_filetypes = "1"
DISTRO_USE_busybox_feature_ls_followlinks = "1"
DISTRO_USE_busybox_feature_ls_recursive = "1"
DISTRO_USE_busybox_feature_ls_sortfiles = "1"
DISTRO_USE_busybox_feature_ls_timestamps = "1"
DISTRO_USE_busybox_feature_ls_username = "1"
DISTRO_USE_busybox_feature_ls_color = "1"
DISTRO_USE_busybox_feature_ls_color_is_default = "1"
DISTRO_USE_busybox_sort = "1"
DISTRO_USE_busybox_feature_fancy_tail = "1"
DISTRO_USE_busybox_uniq = "1"
DISTRO_USE_busybox_usleep = "1"
DISTRO_USE_busybox_wc = "1"
DISTRO_USE_busybox_who = "1"
DISTRO_USE_busybox_whoami = "1"
DISTRO_USE_busybox_feature_preserve_hardlinks = "1"
DISTRO_USE_busybox_chvt = "1"
DISTRO_USE_busybox_clear = "1"
DISTRO_USE_busybox_deallocvt = "1"
DISTRO_USE_busybox_openvt = "1"
DISTRO_USE_busybox_resize = "1"
DISTRO_USE_busybox_feature_vi_readonly = "1"
DISTRO_USE_busybox_feature_vi_setopts = "1"
DISTRO_USE_busybox_feature_vi_set = "1"
DISTRO_USE_busybox_grep = "1"
DISTRO_USE_busybox_feature_grep_egrep_alias = "1"
DISTRO_USE_busybox_feature_grep_fgrep_alias = "1"
DISTRO_USE_busybox_feature_grep_context = "1"
DISTRO_USE_busybox_xargs = "1"
DISTRO_USE_busybox_feature_xargs_support_confirmation = "1"
DISTRO_USE_busybox_feature_xargs_support_quotes = "1"
DISTRO_USE_busybox_feature_xargs_support_termopt = "1"
DISTRO_USE_busybox_feature_xargs_support_zero_term = "1"
DISTRO_USE_busybox_feature_shadowpasswds = "1"
DISTRO_USE_busybox_feature_securetty = "1"
DISTRO_USE_busybox_mount = "1"
DISTRO_USE_busybox_feature_mount_nfs = "0" #depends on glibc with RPC headers, see: http://comments.gmane.org/gmane.comp.lib.uclibc.buildroot/42730
DISTRO_USE_busybox_pivot_root = "1"
DISTRO_USE_busybox_rdate = "1"
DISTRO_USE_busybox_swaponoff = "1"
DISTRO_USE_busybox_feature_mount_loop = "1"
DISTRO_USE_busybox_blkid = "1"
DISTRO_USE_busybox_pidof = "1"
DISTRO_USE_busybox_printenv = "1"
DISTRO_USE_busybox_printf = "1"
DISTRO_USE_busybox_readlink = "1"
DISTRO_USE_busybox_readpath = "1"
DISTRO_USE_busybox_ip = "1"
DISTRO_USE_busybox_feature_ifupdown_ip_builtin = "1"
DISTRO_USE_busybox_telnet = "1"
DISTRO_USE_busybox_telnet_ttype = "1"
DISTRO_USE_busybox_telnet_autologin = "1"
DISTRO_USE_busybox_adduser = "1"
DISTRO_USE_busybox_feature_adduser_long_options = "1"
DISTRO_USE_busybox_deluser = "1"
DISTRO_USE_busybox_feature_find_user = "1"
DISTRO_USE_busybox_feature_find_group = "1"
DISTRO_USE_busybox_addgroup = "1"
DISTRO_USE_busybox_delgroup = "1"
DISTRO_USE_busybox_feature_addgroup_long_options = "1"
DISTRO_USE_busybox_feature_adduser_to_group = "1"
DISTRO_USE_busybox_feature_del_user_from_group = "1"
DISTRO_USE_busybox_delgroup = "1"
DISTRO_USE_busybox_wget = "1"
DISTRO_USE_busybox_feature_wget_statusbar = "1"
DISTRO_USE_busybox_feature_wget_authentication = "1"
DISTRO_USE_busybox_renice = "1"
DISTRO_USE_busybox_mesg = "1"
DISTRO_USE_busybox_tty = "1"
DISTRO_USE_busybox_wall = "1"
DISTRO_USE_busybox_cmp = "1"
DISTRO_USE_busybox_flashcp = "1"
DISTRO_USE_busybox_flash_lock = "1"
DISTRO_USE_busybox_flash_unlock = "1"
DISTRO_USE_busybox_flash_eraseall = "1"
DISTRO_USE_busybox_ftpget = "1"
DISTRO_USE_busybox_ftpput = "1"
DISTRO_USE_busybox_lfs = "1"
DISTRO_USE_busybox_less = "1"
DISTRO_USE_busybox_less_regexp = "1"
DISTRO_USE_busybox_df_fancy = "1"
DISTRO_USE_busybox_ubiattach = "1"
DISTRO_USE_busybox_ubidetach = "1"
DISTRO_USE_busybox_ubimkvol = "1"
DISTRO_USE_busybox_ubirmvol = "1"
DISTRO_USE_busybox_ubirsvol = "1"
DISTRO_USE_busybox_ubiupdatevol = "1"
```

## conf/local.conf.sample
```bitbake
DISTRO	= "bananapir1"
MACHINE = "bpir1"

PROVIDED	 = "all"

# 32-bit Linux SDK (64-bit compatible)
SDK_CPU		 = "i686"
SDK_OS		 = "linux-gnu"

# Uncomment this to keep workdir intact after successful build
RMWORK		 = "0"

# Set this to 1 for defaulting to --relaxed or 2 for defaulting to --sloppy
#DEFAULT_RELAX	 = "1"

# Point to any available prebaked packages
#PREBAKE_PATH	 = "${TOPDIR}/prebake"

# Uncomment these to do enable parallel make
#PARALLEL_MAKE	 = "-j 4"
```

## conf/machine/bpir1.conf
```bitbake
MACHINE_USE_kernel_imagetype = "uImage"
MACHINE_USE_kernel_uimage = "1"
MACHINE_USE_kernel_dts = "sun7i-a20-lamobo-r1.dts"
MACHINE_USE_kernel_defconfig = "sunxi_defconfig"
MACHINE_USE_kernel_uimage_loadaddress = "0x40008000"
MACHINE_USE_kernel_uimage_entrypoint = "0x40008000"

MACHINE_USE_netbase_auto_if = "lo eth0"
MACHINE_USE_busybox_inittab_login = "::respawn:/sbin/getty 115200 /dev/ttyS0 vt100"

MACHINE_CPU	= "arm-cortexa8"
MACHINE_ABI	= "hard"

MACHINE_USE_uboot_config = "Bananapi_defconfig"
```

## recipes/u-boot/files/bpir1_defconfig
```kconfig
CONFIG_SPL=y
CONFIG_SYS_EXTRA_OPTIONS="AXP209_POWER,SUNXI_GMAC,SUNXI_GMAC_TX_DELAY_3,RGMII,MACPWR=SUNXI_GPH(23),AHCI,USB_EHCI"
CONFIG_FDTFILE="sun7i-a20-bpi-m1.dtb"
+S:CONFIG_ARM=y
+S:CONFIG_ARCH_SUNXI=y
+S:CONFIG_MACH_SUN7I=y
+S:CONFIG_TARGET_BANANAPI=y
```
